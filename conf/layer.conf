## conf/layer.conf
```bitbake
# Layer configuration for meta-aaron layer
# Forked from the meta-baryon layer, which was
# Copyright 2011 Intel Corporation

# We have a conf directory, prepend to BBPATH to prefer our versions
BBPATH := "${LAYERDIR}:${BBPATH}"

# We have recipes-* directories, add to BBFILES
BBFILES := "${BBFILES} ${LAYERDIR}/recipes-*/*/*.bb ${LAYERDIR}/recipes-*/*/*.bbappend"

BBFILE_COLLECTIONS += "meta-aaron"
BBFILE_PATTERN_meta-aaron := "^${LAYERDIR}/"
BBFILE_PRIORITY_meta-aaron = "7"
```
